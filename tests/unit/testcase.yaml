## tests/unit/testcase.yaml
```yaml
common:
  tags:
    - ecu
  platform_allow:
    - native_sim/native/64
  integration_platforms:
    - native_sim/native/64
tests:
  ecu.unit:
    harness: ztest
```
